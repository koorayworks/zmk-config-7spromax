## config/boards/shields/7spromax/Kconfig.defconfig
```kconfig
# SPDX-License-Identifier: MIT

if SHIELD_7SPROMAX_LEFT

config ZMK_SPLIT_ROLE_CENTRAL
    default y

endif

if SHIELD_7SPROMAX_LEFT || SHIELD_7SPROMAX_RIGHT

config ZMK_SPLIT
    default y

config ZMK_KEYBOARD_NAME
    default "7sProMax"

endif
```

## config/boards/shields/7spromax/Kconfig.shield
```kconfig
# SPDX-License-Identifier: MIT

config SHIELD_7SPROMAX_LEFT
    def_bool $(shields_list_contains,7spromax_left)

config SHIELD_7SPROMAX_RIGHT
    def_bool $(shields_list_contains,7spromax_right)
```
